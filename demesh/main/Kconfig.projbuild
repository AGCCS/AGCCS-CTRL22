## demesh/main/Kconfig.projbuild
```kconfig
menu "DEMESH Configuration"

choice TARGET_BOARD
    bool "Target Board"
    default TARGET_BOARD_GPIO2
    help
      Set board type for monitoring output (blink etc).
config TARGET_BOARD_NOPE
     bool "Nope (dont touch my hardware)"
config TARGET_BOARD_M5
     bool "M5StickC (report status via built-in TFT)"
config TARGET_BOARD_GPIO2
     bool "Barebones with LED on GPIO 2"
config TARGET_BOARD_FGCCS_1_0
     bool "AGCCS board, rev 1.0"
config TARGET_BOARD_FGCCS_1_2
     bool "AGCCS board, rev 1.2"
endchoice


config ROUTER_SSID
    string "Router SSID"
        default "ROUTER_SSID"
        help
            Router SSID.

config ROUTER_PASSWORD
    string "Router password"
        default "12345678"
        help
            Router password.

config MESH_ID
    string "Mesh ID"
        default "123456"
        help
            Mesh network identification, Nodes with the same mesh ID can
            communicate with each other. Should be six printable ASCII characters.

config MESH_PASSWORD
    string "Mesh Password"
    default "12345678"
    help
        Mesh AP password.

config UPSTREAM_SERVER_IP
    string "Upstream server IP address"
        default "192.168.5.1"
        help
            Server IP address.

config UPSTREAM_SERVER_PORT
    int "Upstream server port"
        default "8070"
        help
            Server port.

config FIRMWARE_SERVER_IP
    string "Firmware server IP address"
        default "192.168.5.1"
        help
            Server IP address.

config FIRMWARE_SERVER_PORT
    int "Firmware server port"
        default "8070"
        help
            Server port.

config FIRMWARE_BASENAME
    string "Firmware filename (w/o extension)"
    default "demesh"
    help
        Base of firmware file, no versions, no extension.

config MQTT_BROKER_URL
    string "MQTT broker address"
        default "mqtt://192.168.5.1:1883"
        help
            Typically same as firmware server.

config SOFTAP_SSID
    string "Soft AP SSID (debugging AVR)"
        default "DebugAVR"
        help
            Soft AP SSID.

config SOFTAP_PASSWORD
    string "Soft AP password (debugging AVR)"
        default "SOFTAP_PASSWORD"
        help
            Soft AP password.

config DEBUG_SERVER_IP
    string "Debug server IP address"
        default "192.168.4.1"
        help
            Server IP address.

config DEBUG_TELNET_PORT
    int "Debug telnet Server port"
        default "23"
        help
            Server port.

config DEBUG_OPTIBOOT_PORT
    int "Debug optiboot Server port"
        default "2323"
        help
            Server port.


endmenu
```
